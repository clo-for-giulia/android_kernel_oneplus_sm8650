## drivers/misc/oplus_power_notifier/Kconfig
```kconfig
#
# oplus power notifier driver configuration
#

config OPLUS_POWER_NOTIFIER
	tristate "oplus power notifier"
	help
	  Say Y here if you use oplus power notifier.
	  If unsure, say N.
```
